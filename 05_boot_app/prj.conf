## CMakeLists.txt
```
# Minimum CMake version
cmake_minimum_required(VERSION 3.22.0)

# Locate the Zephyr RTOS source
find_package(Zephyr REQUIRED HINTS $ENV{ZEPHYR_BASE})

# Name the project
project(blinky)

# Locate the source code for the application
target_sources(app PRIVATE src/main.c)
```

## prj.conf
```kconfig
CONFIG_BOOTLOADER_MCUBOOT=y

#CONFIG_MCUBOOT_GENERATE_UNSIGNED_IMAGE=y
CONFIG_MCUBOOT_SIGNATURE_KEY_FILE="/home/mcb/mcuboot-signing-key.pem"
```

## boards/stm32f3_disco.overlay
```dts
/ {
    aliases {
        /* To change the application and see it working we can just switch LED colour */
        my-led = &red_led_3;
        /* my-led = &blue_led_4;  */
    };
};
```

## src/main.c
```c
#include <stdio.h>
#include <zephyr/kernel.h>
#include <zephyr/drivers/gpio.h>

static const int32_t sleep_time_ms = 1000;

static const struct gpio_dt_spec led = GPIO_DT_SPEC_GET(DT_ALIAS(my_led), gpios);

int main(void)
{

	// Make sure that the GPIO was initialized
	if (!gpio_is_ready_dt(&led)) {
		return 0;
	}

	// Set the GPIO as output
	int ret = gpio_pin_configure_dt(&led, GPIO_OUTPUT);
	if (ret < 0) {
		return 0;
	}

	int state = 0;

	// Do forever
	while (1) {

		// Change the state of the pin and print
		state = !state;

		// Set pin state
		ret = gpio_pin_set_dt(&led, state);
		if (ret < 0) {
			return 0;
		}

		// Sleep
		k_msleep(sleep_time_ms);
	}

	return 0;
}
```

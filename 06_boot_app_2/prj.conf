## prj.conf
```kconfig
CONFIG_BOOTLOADER_MCUBOOT=y

#CONFIG_MCUBOOT_GENERATE_UNSIGNED_IMAGE=y
CONFIG_MCUBOOT_SIGNATURE_KEY_FILE="/home/mcb/mcuboot-signing-key.pem"

# Flash access
CONFIG_FLASH=y
CONFIG_FLASH_MAP=y
CONFIG_STREAM_FLASH=y

# DFU image manager — provides boot_write_img_confirmed()
CONFIG_IMG_MANAGER=y

# MCUmgr core + CBOR + framing dependencies
CONFIG_NET_BUF=y
CONFIG_ZCBOR=y
CONFIG_CRC=y
CONFIG_BASE64=y
CONFIG_MCUMGR=y

# Image management (upload/list/confirm) and OS management (reset) command groups
CONFIG_MCUMGR_GRP_IMG=y
CONFIG_MCUMGR_GRP_OS=y

# UART transport for SMP frames
CONFIG_UART_MCUMGR=y
CONFIG_MCUMGR_TRANSPORT_UART=y

# MCUmgr command handlers need more stack than the blinky defaults
CONFIG_SYSTEM_WORKQUEUE_STACK_SIZE=2304
CONFIG_MAIN_STACK_SIZE=2176

CONFIG_UART_INTERRUPT_DRIVEN=y
```

## boards/stm32f3_disco.overlay
```dts
/ {
    chosen {
        zephyr,uart-mcumgr = &usart1;
    };

    aliases {
        /* To change the application and see it working we can just switch LED colour */
        /* my-led = &red_led_3; */
        my-led = &blue_led_4;
    };
};
```

## src/main.c
```c
#include <stdio.h>
#include <zephyr/kernel.h>
#include <zephyr/drivers/gpio.h>
#include <zephyr/dfu/mcuboot.h>

static const int32_t sleep_time_ms = 1000;

static const struct gpio_dt_spec led = GPIO_DT_SPEC_GET(DT_ALIAS(my_led), gpios);

int main(void)
{
	/* Mark this image as confirmed so MCUboot won't revert it on next reset */
	boot_write_img_confirmed();

	// Make sure that the GPIO was initialized
	if (!gpio_is_ready_dt(&led)) {
		return 0;
	}

	// Set the GPIO as output
	int ret = gpio_pin_configure_dt(&led, GPIO_OUTPUT);
	if (ret < 0) {
		return 0;
	}

	int state = 0;

	// Do forever
	while (1) {

		// Change the state of the pin and print
		state = !state;

		// Set pin state
		ret = gpio_pin_set_dt(&led, state);
		if (ret < 0) {
			return 0;
		}

		// Sleep
		k_msleep(sleep_time_ms);
	}

	return 0;
}
```

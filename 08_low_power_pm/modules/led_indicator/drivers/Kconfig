## 08_low_power_pm/modules/led_indicator/drivers/led_indicator/Kconfig
```kconfig
config LED_INDICATOR
	bool "Example LED indicator driver"
	default n
	depends on GPIO && PM_DEVICE
	help
	  Enable the led_indicator out-of-tree device driver.
```

## 08_low_power_pm/modules/led_indicator/dts/bindings/example,led-indicator.yaml
```yaml
description: Example LED indicator driver

compatible: "example,led-indicator"

include: base.yaml

properties:
  status-gpios:
    type: phandle-array
    required: true
    description: GPIO pin used as the awake/status indicator LED
```

## 10_pm_shell/modules/led_indicator/dts/bindings/example,led-indicator.yaml
```yaml
description: Example LED indicator driver

compatible: "example,led-indicator"

include: base.yaml

properties:
  status-gpios:
    type: phandle-array
    required: true
    description: GPIO pin for the LED controlled by this driver
```
